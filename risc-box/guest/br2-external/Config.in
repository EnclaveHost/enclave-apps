## risc-box/guest/br2-external/package/garcon/Config.in
```kconfig
config BR2_PACKAGE_GARCON
	bool "garcon"
	select BR2_PACKAGE_LIBXFCE4UTIL
	select BR2_PACKAGE_LIBXFCE4UI
	select BR2_PACKAGE_LIBGTK3
	select BR2_PACKAGE_LIBGTK3_X11
	depends on BR2_PACKAGE_XORG7
	depends on BR2_USE_MMU
	depends on BR2_TOOLCHAIN_HAS_THREADS
	help
	  XFCE desktop component: garcon.

	  https://docs.xfce.org/
```

## risc-box/guest/br2-external/package/libwnck3/Config.in
```kconfig
config BR2_PACKAGE_LIBWNCK3
	bool "libwnck3"
	select BR2_PACKAGE_LIBGTK3
	select BR2_PACKAGE_LIBGTK3_X11
	select BR2_PACKAGE_LIBGLIB2
	select BR2_PACKAGE_XLIB_LIBXRES
	depends on BR2_PACKAGE_XORG7
	depends on BR2_USE_MMU
	depends on BR2_TOOLCHAIN_HAS_THREADS
	help
	  Window Navigator Construction Kit: the library window managers
	  and taskbars use to enumerate and control windows. xfwm4 and
	  xfce4-panel both need it.

	  https://gitlab.gnome.org/GNOME/libwnck
```

## risc-box/guest/br2-external/package/libxfce4util/Config.in
```kconfig
config BR2_PACKAGE_LIBXFCE4UTIL
	bool "libxfce4util"
	select BR2_PACKAGE_LIBGLIB2
	depends on BR2_PACKAGE_XORG7
	depends on BR2_USE_MMU
	depends on BR2_TOOLCHAIN_HAS_THREADS
	help
	  XFCE desktop component: libxfce4util.

	  https://docs.xfce.org/
```

## risc-box/guest/br2-external/package/xfce4-session/Config.in
```kconfig
config BR2_PACKAGE_XFCE4_SESSION
	bool "xfce4-session"
	select BR2_PACKAGE_LIBXFCE4UI
	select BR2_PACKAGE_LIBXFCE4UTIL
	select BR2_PACKAGE_XFCONF
	select BR2_PACKAGE_LIBWNCK3
	select BR2_PACKAGE_LIBGTK3
	select BR2_PACKAGE_LIBGTK3_X11
	depends on BR2_PACKAGE_XORG7
	depends on BR2_USE_MMU
	depends on BR2_TOOLCHAIN_HAS_THREADS
	help
	  XFCE desktop component: xfce4-session.

	  https://docs.xfce.org/
```

## risc-box/guest/br2-external/package/xfce4-settings/Config.in
```kconfig
config BR2_PACKAGE_XFCE4_SETTINGS
	bool "xfce4-settings"
	select BR2_PACKAGE_LIBXFCE4UI
	select BR2_PACKAGE_LIBXFCE4UTIL
	select BR2_PACKAGE_XFCONF
	select BR2_PACKAGE_GARCON
	select BR2_PACKAGE_EXO
	select BR2_PACKAGE_XLIB_LIBXI
	select BR2_PACKAGE_FONTCONFIG
	select BR2_PACKAGE_XLIB_LIBX11
	select BR2_PACKAGE_LIBGTK3
	select BR2_PACKAGE_LIBGTK3_X11
	depends on BR2_PACKAGE_XORG7
	depends on BR2_USE_MMU
	depends on BR2_TOOLCHAIN_HAS_THREADS
	help
	  XFCE desktop component: xfce4-settings.

	  https://docs.xfce.org/
```

## risc-box/guest/br2-external/package/xfconf/Config.in
```kconfig
config BR2_PACKAGE_XFCONF
	bool "xfconf"
	select BR2_PACKAGE_LIBXFCE4UTIL
	select BR2_PACKAGE_DBUS
	select BR2_PACKAGE_LIBGLIB2
	depends on BR2_PACKAGE_XORG7
	depends on BR2_USE_MMU
	depends on BR2_TOOLCHAIN_HAS_THREADS
	help
	  XFCE desktop component: xfconf.

	  https://docs.xfce.org/
```

## risc-box/guest/br2-external/package/xfdesktop/Config.in
```kconfig
config BR2_PACKAGE_XFDESKTOP
	bool "xfdesktop"
	select BR2_PACKAGE_LIBXFCE4UI
	select BR2_PACKAGE_LIBXFCE4UTIL
	select BR2_PACKAGE_GARCON
	select BR2_PACKAGE_EXO
	select BR2_PACKAGE_LIBWNCK3
	select BR2_PACKAGE_LIBGTK3
	select BR2_PACKAGE_LIBGTK3_X11
	depends on BR2_PACKAGE_XORG7
	depends on BR2_USE_MMU
	depends on BR2_TOOLCHAIN_HAS_THREADS
	help
	  XFCE desktop component: xfdesktop.

	  https://docs.xfce.org/
```

## risc-box/guest/br2-external/package/xfwm4/Config.in
```kconfig
config BR2_PACKAGE_XFWM4
	bool "xfwm4"
	select BR2_PACKAGE_LIBXFCE4UI
	select BR2_PACKAGE_LIBXFCE4UTIL
	select BR2_PACKAGE_LIBWNCK3
	select BR2_PACKAGE_XLIB_LIBXINERAMA
	select BR2_PACKAGE_XFCONF
	select BR2_PACKAGE_LIBGTK3
	select BR2_PACKAGE_LIBGTK3_X11
	depends on BR2_PACKAGE_XORG7
	depends on BR2_USE_MMU
	depends on BR2_TOOLCHAIN_HAS_THREADS
	help
	  XFCE desktop component: xfwm4.

	  https://docs.xfce.org/
```
